## esp32_ci1006-master/components/userconfig/Kconfig
```kconfig
menu "ESP IOT App"

choice NETWORK_MODE
    prompt "Device Network Mode"
    default CONFIG_ETH_MODE
    help
        Select the Device Working Mode.

config ETH_MODE
    bool "ETH"
    help
        Select this to eth mode

config WIFI_MODE
    bool "WIFI"
    help
        Select this to wifi mode

endchoice


config ESP_AUDIO_WIFI_SSID
    string "WI-FI SSID"
    default "SSID"
    help
        Add WIFI SSID.
config ESP_AUDIO_WIFI_PWD
    string "WI-FI password"
    default "password"
    help
        Add WIFI password.

choice PHY_MODEL
    prompt "Ethernet PHY"
    default CONFIG_PHY_TLK110
    help
        Select the PHY driver to use for the example.

config PHY_TLK110
    bool "TI TLK110 PHY"
    help
        Select this to use the TI TLK110 PHY

config PHY_LAN8720
    bool "Microchip LAN8720 PHY"
    help
        Select this to use the Microchip LAN8720 PHY

endchoice


config PHY_ADDRESS
    int "PHY Address (0-31)"
    default 31
    range 0 31
    help
        Select the PHY Address (0-31) for the hardware configuration and PHY model.
        TLK110 default 31
        LAN8720 default 1 or 0


choice PHY_CLOCK_MODE
    prompt "EMAC clock mode"
    default PHY_CLOCK_GPIO0_IN
    help
        Select external (input on GPIO0) or internal (output on GPIO16 or GPIO17) clock


config PHY_CLOCK_GPIO0_IN
    bool "GPIO0 input"
    help
        Input of 50MHz refclock on GPIO0

config PHY_CLOCK_GPIO16_OUT
    bool "GPIO16 output"
    help
        Output the internal 50MHz APLL clock on GPIO16

config PHY_CLOCK_GPIO17_OUT
    bool "GPIO17 output (inverted)"
    help
        Output the internal 50MHz APLL clock on GPIO17 (inverted signal)

endchoice

config PHY_CLOCK_MODE
    int
    default 0 if PHY_CLOCK_GPIO0_IN
    default 2 if PHY_CLOCK_GPIO16_OUT
    default 3 if PHY_CLOCK_GPIO17_OUT


config PHY_USE_POWER_PIN
    bool "Use PHY Power (enable/disable) pin"
    default y
    help
        Use a GPIO "power pin" to power the PHY on/off during operation.
        Consult the example README for more details

config PHY_POWER_PIN
    int "PHY Power GPIO"
    default 17
    range 0 33
    depends on PHY_USE_POWER_PIN
    help
        GPIO number to use for powering on/off the PHY.

config PHY_SMI_MDC_PIN
    int "SMI MDC Pin"
    default 23
    range 0 33
    help
        GPIO number to use for SMI clock output MDC to PHY.

config PHY_SMI_MDIO_PIN
    int "SMI MDIO Pin"
    default 18
    range 0 33
    help
       GPIO number to use for SMI data pin MDIO to/from PHY.

config PHY_DISABLE_DHCP
    bool "Disable DHCP"
    default n
    help
       DHCP function

config PHY_IP
    string "IP"
    default "192.168.0.128"
    depends on PHY_DISABLE_DHCP
    help
        ETH IP.

config PHY_GW
    string "GW"
    default "192.168.0.1"
    depends on PHY_DISABLE_DHCP
    help
        ETH GW.

config PHY_MASK
    string "MASK"
    default "255.255.255.0"
    depends on PHY_DISABLE_DHCP
    help
        ETH MASK.
endmenu
```

## esp32_ci1006-master/sdkconfig.defaults
```kconfig
#
# Serial flasher config
#
CONFIG_ESPTOOLPY_BAUD_921600B=y
CONFIG_ESPTOOLPY_FLASHFREQ_80M=y
CONFIG_ESPTOOLPY_FLASHFREQ="80m"
CONFIG_ESPTOOLPY_FLASHSIZE_4MB=y
CONFIG_ESPTOOLPY_FLASHSIZE="4MB"



#
# Partition Table
#
CONFIG_PARTITION_TABLE_CUSTOM=y
CONFIG_PARTITION_TABLE_CUSTOM_FILENAME="partitions.csv"
CONFIG_PARTITION_TABLE_CUSTOM_APP_BIN_OFFSET=0x10000
CONFIG_PARTITION_TABLE_FILENAME="partitions.csv"
CONFIG_APP_OFFSET=0x10000

#
# Compiler options
#

CONFIG_OPTIMIZATION_LEVEL_RELEASE=y


#
# ESP32-specific
#
CONFIG_ESP32_DEFAULT_CPU_FREQ_240=y
CONFIG_ESP32_DEFAULT_CPU_FREQ_MHZ=240


#
# FreeRTOS
#
#CONFIG_FREERTOS_USE_TRACE_FACILITY=y
#CONFIG_FREERTOS_USE_STATS_FORMATTING_FUNCTIONS=y
#CONFIG_FREERTOS_GENERATE_RUN_TIME_STATS=y
#CONFIG_FREERTOS_RUN_TIME_STATS_USING_ESP_TIMER=y
#CONFIG_FREERTOS_RUN_TIME_STATS_USING_CPU_CLK=


#
# ESP Light App
#
CONFIG_ESP_AUDIO_WIFI_SSID="haolianqiang"
CONFIG_ESP_AUDIO_WIFI_PWD="123456hao"
CONFIG_PHY_LAN8720=y
CONFIG_PHY_ADDRESS=0
CONFIG_PHY_CLOCK_GPIO0_IN=y
CONFIG_PHY_CLOCK_MODE=0
CONFIG_PHY_USE_POWER_PIN=y
CONFIG_PHY_POWER_PIN=33
CONFIG_PHY_SMI_MDC_PIN=18
CONFIG_PHY_SMI_MDIO_PIN=23
```
